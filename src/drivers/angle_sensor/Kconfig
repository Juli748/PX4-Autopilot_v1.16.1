## src/drivers/angle_sensor/aoa_vane_as5600/Kconfig
```kconfig
menuconfig DRIVERS_ANGLE_SENSOR_AOA_VANE_AS5600
	bool "AoA vane (AS5600)"
	default n
	---help---
		Enable support for an angle-of-attack vane that uses the AS5600 magnetic hall effect sensor.
```

## src/drivers/angle_sensor/as5600/Kconfig
```kconfig
menuconfig DRIVERS_ANGLE_SENSOR_AS5600
	bool "as5600"
	default n
	---help---
		Enable support for the AS5600 magnetic angle sensor.
```

## src/drivers/distance_sensor/vld1_radar/Kconfig
```kconfig
menuconfig DRIVERS_DISTANCE_SENSOR_VLD1_RADAR
	bool "vld1_radar"
	default n
	---help---
		Enable support for vld1_radar
```

## src/drivers/rc/srxl2_rc/Kconfig
```kconfig
menuconfig DRIVERS_RC_SRXL2_RC
	bool "srxl2_rc"
	default y
	---help---
		Enable support for Spektrum SRXL2 RC input.
```
